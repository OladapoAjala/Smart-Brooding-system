#include <ESP8266WiFi.h>
#include <MQTT.h>
#include <Wire.h>
#include <Adafruit_GFX.h>
#include <Adafruit_SSD1306.h>
#include <ArduinoJson.h>

extern "C" {
#include <espnow.h>
#include "user_interface.h"
}

//Call prototypes for MQTT
void myPublishedCb();
void myDisconnectedCb();
void myConnectedCb();

//// create MQTT object
MQTT myMqtt("Smart_Brooder", "test.mosquitto.org", 1883);
const char* ssid     = "Kolade";
const char* password = "1441mf3h";
String heater_state = "0";

#define SCREEN_WIDTH 128 // OLED display width, in pixels
#define SCREEN_HEIGHT 64 // OLED display height, in pixels
#define WIFI_CHANNEL 1

uint8_t ap_mac_address[] = {0xAA, 0xAA, 0xAA, 0xAA, 0xAA, 0xAA };
uint8_t sta_mac_address[] = { 0xAA, 0xAA, 0xAA, 0xAA, 0xAA, 0xAB };
uint8_t actuator_1_mac[] = {0xAA, 0xAA, 0xAA, 0xAA, 0xAA, 0xA1};


void initVariant() {
  WiFi.mode(WIFI_AP_STA);
  wifi_set_macaddr(STATION_IF, &sta_mac_address[0]);
  wifi_set_macaddr(SOFTAP_IF, &ap_mac_address[0]);
}

// keep in sync with ESP_NOW sensor struct
struct __attribute__((packed)) SENSOR_DATA {
  String sensor_name = "N_1";
  float temp = 0;
  float humidity = 0;
  bool state = true;
} sensorData;

// Declaration for an SSD1306 display connected to I2C (SDA, SCL pins)
Adafruit_SSD1306 display(SCREEN_WIDTH, SCREEN_HEIGHT, &Wire, -1);

// 'OAU_logo', 128x64px
const unsigned char OAU_logo [] PROGMEM = {
  0x00, 0x00, 0x00, 0x00, 0x00, 0x0f, 0xff, 0xff, 0xff, 0xff, 0xfc, 0x00, 0x00, 0x00, 0x00, 0x00,
  0x00, 0x00, 0x00, 0x00, 0x00, 0x0f, 0xff, 0xff, 0xff, 0xff, 0xfc, 0x00, 0x00, 0x00, 0x00, 0x00,
  0x00, 0x00, 0x00, 0x00, 0x00, 0x0f, 0xff, 0xff, 0xff, 0xff, 0xfc, 0x00, 0x00, 0x00, 0x00, 0x00,
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  0x00, 0x00, 0x00, 0x00, 0x00, 0x00, 0x00, 0x0f, 0xf0, 0x00, 0x00, 0x00, 0x00, 0x00, 0x00, 0x00
};

void setup() {
  Serial.begin(115200); Serial.println();
  
  if (!display.begin(SSD1306_SWITCHCAPVCC, 0x3C)) {
    Serial.println(F("SSD1306 allocation failed"));
    for (;;);
  }

  WiFi.begin(ssid, password);
  display.clearDisplay();
  display.setTextColor(WHITE);
  display.setTextSize(2);
  display.setCursor(0, 0);
  display.print("Connecting to WiFi..");
  display.display();

  while (WiFi.status() != WL_CONNECTED) {
    delay(50);
    Serial.print(".");
  }

  delay(1000);
  display.clearDisplay();
  display.setTextColor(WHITE);
  display.setTextSize(2);
  display.setCursor(0, 0);
  display.print("Connected!");
  display.display();

  Serial.print("This node AP mac: "); Serial.println(WiFi.softAPmacAddress());
  Serial.print("This node STA mac: "); Serial.println(WiFi.macAddress());

  delay(2000);
  display.clearDisplay();
  display.setTextColor(WHITE);
  display.setTextSize(2);
  display.setCursor(0, 0);
  display.print("Setting up MQTT!");
  display.display();

  //setup callbacks
  myMqtt.onConnected(myConnectedCb);
  myMqtt.onDisconnected(myDisconnectedCb);
  myMqtt.onPublished(myPublishedCb);
  myMqtt.onData(myDataCb);

  Serial.println("connect mqtt...");
  myMqtt.connect();
  myMqtt.subscribe("/agrilab/switch");

  delay(2000);
  display.clearDisplay();
  display.setTextColor(WHITE);
  display.setTextSize(2);
  display.setCursor(0, 0);
  display.print("Connected to Broker!");
  display.display();

  delay(2000);
  display.clearDisplay();
  display.setTextColor(WHITE);
  display.setTextSize(2);
  display.setCursor(0, 0);
  display.print("Initialize ESP NOW!");
  display.display();

  initEspNow();

  delay(2000);
  display.clearDisplay();
  display.drawBitmap(0, 0, OAU_logo, 128, 64, WHITE);
  display.display();
  delay(3000);
}

void loop() {

    if (sensorData.sensor_name == "N_1") {
      myMqtt.publish("/agrilab/nodeone/temperature", temperature);
      myMqtt.publish("/agrilab/nodeone/humidity", humidity);
    } else if (sensorData.sensor_name == "N_2") {
      myMqtt.publish("/agrilab/nodetwo/temperature", temperature);
      myMqtt.publish("/agrilab/nodetwo/humidity", humidity);
    } else if (sensorData.sensor_name == "N_3") {
      myMqtt.publish("/agrilab/nodethree/temperature", temperature);
      myMqtt.publish("/agrilab/nodethree/humidity", humidity);
    } else if (sensorData.sensor_name == "N_4") {
      myMqtt.publish("/agrilab/nodefour/temperature", temperature);
      myMqtt.publish("/agrilab/nodefour/humidity", humidity);
    } else if (sensorData.sensor_name == "N_5") {
      myMqtt.publish("/agrilab/nodefive/temperature", temperature);
      myMqtt.publish("/agrilab/nodefive/humidity", humidity);
    }
    print_temp(sensorData.temp, sensorData.humidity);
    delay(2000);
}

void initEspNow() {
  if (esp_now_init() != 0) {
    Serial.println("*** ESP_Now initialization failed ***");
    ESP.restart();
  }
  Serial.println(sizeof(sensorData));

  esp_now_set_self_role(ESP_NOW_ROLE_COMBO);
  esp_now_add_peer(actuator_1_mac, ESP_NOW_ROLE_SLAVE, WIFI_CHANNEL, NULL, 0);
  esp_now_register_recv_cb([](uint8_t *mac, uint8_t *data, uint8_t len) {

    memcpy(&sensorData, data, sizeof(sensorData));

    Serial.printf("Received data from: ");
    Serial.println(sensorData.sensor_name);
    Serial.printf("Temperature = %0.3f\n"
                  "Humidity = %0.3f% \n",
                  sensorData.temp,
                  sensorData.humidity);

    {
      if (sensorData.temp < 28) {
        sensorData.state = true;
        heater_state = "1";

        uint8_t data[sizeof(sensorData)];
        memcpy(data, &sensorData, sizeof(sensorData));

        esp_now_send(actuator_1_mac, data, sizeof(sensorData));
      } else {
        sensorData.state = false;
        heater_state = "0";

        uint8_t data[sizeof(sensorData)];
        memcpy(data, &sensorData.state, sizeof(sensorData));
        esp_now_send(actuator_1_mac, data, sizeof(sensorData));
      }
      myMqtt.publish("/agrilab/switch", heater_state);
    }
  });
  esp_now_register_send_cb([](uint8_t* mac, uint8_t sendStatus) {
    Serial.println("Data sent!");
  });
}

void print_temp (float temperature, float humidity)
{
  display.clearDisplay();
  display.setTextColor(WHITE);
  display.setTextSize(2);
  display.setCursor(0, 0);
  display.print(sensorData.sensor_name);
  display.print(" Temp: ");
  display.setTextSize(3);
  display.setCursor(0, 30);
  display.print(temperature);
  display.setTextSize(2);
  display.cp437(true);
  display.write(167);
  display.setTextSize(3);
  display.print("C");
  display.display();

  delay(5000);
  //display humidity
  display.clearDisplay();
  display.setTextColor(WHITE);
  display.setTextSize(2);
  display.setCursor(0, 0);
  display.print(sensorData.sensor_name);
  display.print(" Hum:");
  display.setTextSize(3);
  display.setCursor(0, 30);
  display.print(humidity);
  display.print(" %");

  display.display();
}

void myConnectedCb()
{
  Serial.println("connected to MQTT server");
}

void myDisconnectedCb()
{
  Serial.println("disconnected. try to reconnect...");
  delay(500);
  myMqtt.connect();
}

void myPublishedCb()
{
  Serial.println("published.");
}

void myDataCb(String& topic, String& data)
{
  Serial.print(topic);
  Serial.print(": ");
  Serial.println(data);

  if (topic == "/agrilab/switch") {
    heater_state = data;
  }
}
